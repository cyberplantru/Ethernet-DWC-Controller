char auth[] = "YourAuthToken"; // You should get Auth Token in the Blynk App.
byte arduino_mac[] = { 0x90, 0xA2, 0xDA, 0x20, 0xE2, 0xE1 }; // You should get MAC address generated by https://ssl.crox.net/arduinomac/
/*
  Example code for the Ethernet pH Corrector v.5.3
  
  http://www.cyber-plant.com
  by CyberPlant LLC, 24 December 2015
  This example code is in the public domain.
*/
#include <Wire.h>
#include <I2C_Anything.h>
#include <SPI.h>
#include <Ethernet.h>
#include <BlynkSimpleEthernet.h>
#include <EEPROM.h>
#define pHtoI2C 0x48
#define pumpPhup 6             // pump pH Up
#define pumpPhdown 5           // pump pH Down
#define PT_TC               0.3850
#define PT_RES_NOMINAL      101.95 // +- 0.39 for pt100
#define T 273.15 // degrees Kelvin

WidgetLED lan(V19);
WidgetLED level(V20);


// Read the settings from non-volatile memory :
float IsoP;
float alphaL;
float alphaH;
float pHlow;
float pHhigh;
float dose;
float LogUp;
float LogDown;
int pHdelay;
int PHMode;
int Lock;

int tube = 50;
int c = 0;
int tempMode = 1; //EEPROM.readInt(addressTempMode);
int manualTemp = 25.0; //EEPROM.readInt(addressManualTemp);
volatile boolean haveData = false;

int s = -1; //переменная для delay
int flag = 0;

int z = 0;
int b = 0;

enum { REG = 9 }; // pin D9 is SS line for LMP91200
const byte SLAVE_ADDRESS = 9;

float voltage, data;
byte highbyte, lowbyte, configRegister;

float pH;
volatile float temp;
volatile byte sensorLevel;
float tempManual = 25.0;
float PT_CAL;
int err_temp = 0;

float itrue;

const int numReadings_voltage = 10;
float readings_voltage[numReadings_voltage];      // the readings from the analog input
int index_voltage = 0;                  // the index of the current reading
float total_voltage = 0;                  // the running total
float average_voltage = 0;                // the average

const int numReadingstemp = 30;
float readingstemp[numReadingstemp];      // the readings from the analog input
int indextemp = 0;                  // the index of the current reading
float totaltemp = 0;                  // the running total
float averagetemp = 0;                // the average

unsigned int Interval = 1000;
long previousMillis = 0;
unsigned long Time;

int sequence = 0;


int cal_7 = 0;

void writeLMP91200(int ss_pin, uint16_t value) // SPI LMP91200
{
  digitalWrite(ss_pin, LOW);
  SPI.transfer(highByte(value));
  SPI.transfer(lowByte(value));
  digitalWrite(ss_pin, HIGH);

}


void setup()
{
  pinMode(A1, INPUT_PULLUP); //leval sensor

  Blynk.begin(auth, "cloud.blynk.cc", 8442, arduino_mac);
  while (Blynk.connect() == false) {
    // Wait until connected
  }
  pinMode(8, OUTPUT); // Relay
  Wire.begin();
  SPI.setBitOrder(MSBFIRST);
  SPI.setClockDivider(SPI_CLOCK_DIV16);
  SPI.setDataMode(SPI_MODE3);
  SPI.begin();
  pinMode(REG, OUTPUT);
  writeLMP91200(REG, 0x0000); // read pH

  Time = millis();

  for (int thisReading_voltage = 0; thisReading_voltage < numReadings_voltage; thisReading_voltage++)
    readings_voltage[thisReading_voltage] = 0;

  for (int thisReadingtemp = 0; thisReadingtemp < numReadingstemp; thisReadingtemp++)
    readingstemp[thisReadingtemp] = 0;

  Read_EE();

  delay(250);
}

struct MyObject {
  float IsoP;
  float alphaL;
  float alphaH;
  float pHlow;
  float pHhigh;
  float dose;
  float LogUp;
  float LogDown;
  int pHdelay;
  int PHMode;
  int Lock;
};

void Read_EE()
{
  int eeAddress = 0;

  MyObject customVar;
  EEPROM.get(eeAddress, customVar);

  IsoP = (customVar.IsoP);
  alphaL = (customVar.alphaL);
  alphaH = (customVar.alphaH);
  pHlow = (customVar.pHlow);
  pHhigh = (customVar.pHhigh);
  dose = (customVar.dose);
  LogUp = (customVar.LogUp);
  LogDown = (customVar.LogDown);
  pHdelay = (customVar.pHdelay);
  PHMode = (customVar.PHMode);
  Lock = (customVar.Lock);
}


void pH_read() // read ADS
{
  Wire.requestFrom(pHtoI2C, 3);
  while (Wire.available()) // ensure all the data comes in
  {
    highbyte = Wire.read(); // high byte * B11111111
    lowbyte = Wire.read(); // low byte
    configRegister = Wire.read();
  }
  data = highbyte * 256;
  data = data + lowbyte;
  voltage = data * 2.048 ;
  voltage = voltage / 32768;

  total_voltage = total_voltage - readings_voltage[index_voltage];
  readings_voltage[index_voltage] = voltage;
  total_voltage = total_voltage + readings_voltage[index_voltage];
  index_voltage = index_voltage + 1;
  if (index_voltage >= numReadings_voltage)
    index_voltage = 0;
  average_voltage = total_voltage / numReadings_voltage;
  voltage = average_voltage;
}

void pH_calculate() // calculate pH
{
  if (voltage > 0)
    pH = IsoP - alphaL * (T + temp) * voltage;
  else if (voltage < 0)
    pH = IsoP - alphaH * (T + temp) * voltage;
}
/*
  float temp_read() // calculate pH
  {
    voltage = ADSread();
    totaltemp= totaltemp - readingstemp[indextemp];
    readingstemp[indextemp] = ((voltage/PT_CAL)* PT_CAL - PT_RES_NOMINAL) / PT_TC;
    totaltemp= totaltemp + readingstemp[indextemp];
    indextemp = indextemp + 1;
    // if we're at the end of the array...
    if (indextemp >= numReadingstemp)
    // ...wrap around to the beginning:
    indextemp = 0;
    averagetemp = totaltemp / numReadingstemp;
    temp = averagetemp;
  }
*/

/*---------------------------------------Buttons------------------------------------------*/

BLYNK_WRITE(V12) // Locking pH calibration and nulling a logs
{
  Lock = param.asInt();
  SaveSet();
}

BLYNK_WRITE(V4) // Auto mode / manual
{
  PHMode = param.asInt();
  SaveSet();
}
/*---------------------------------------I/O of Pumps and nulling of Logs------------------------------------------*/

BLYNK_WRITE(V6)
{
  if (param.asInt() == 1 && Lock == 0)
  {
    LogDown = 0;
  }
  else if (param.asInt() == 1 && Lock == 1)
  {
    pumpPhdown_On();
  }
  SaveSet();
}

BLYNK_WRITE(V7)
{
  if (param.asInt() == 1 && Lock == 0)
  {
    LogUp = 0;
  }
  else if (param.asInt() == 1 && Lock == 1)
  {
    pumpPhup_On();
  }
  SaveSet();
}

/*---------------------------------------Auto pH correction setting------------------------------------------*/
BLYNK_WRITE(V8) // set high of pH
{
  pHhigh = (param.asDouble() / 10);
  z = 1;
}

BLYNK_WRITE(V9) // set low of pH
{
  pHlow = (param.asDouble() / 10);
  z = 2;
}

BLYNK_WRITE(V10) // Dosage for pumps
{
  dose = param.asDouble() / 10;
  z = 3;
}

BLYNK_WRITE(V11) // set an interval of correction
{
  pHdelay = param.asInt();
  z = 4;
}


/*---------------------------------------Calibration of pH sensor------------------------------------------*/


BLYNK_WRITE(V15)
{
  if (Lock == 0 && flag == 0)
  {
    flag = 1;
    Blynk.virtualWrite(V2, "CAL.4");
    Blynk.virtualWrite(V3, "pH");
    alphaL = (IsoP - 4) / voltage / (T + temp);
    SaveSet();
  }
  else if (Lock == 0 && flag == 1)
  {
    flag = 0;
  }
}

BLYNK_WRITE(V16)
{
  if (Lock == 0 && flag == 0)
  {
    flag = 1;
    Blynk.virtualWrite(V2, "CAL.7");
    Blynk.virtualWrite(V3, "pH");
    IsoP = (IsoP - pH + 7.00);
    SaveSet();
  }
  else if (Lock == 0 && flag == 1)
  {
    flag = 0;
  }
}

BLYNK_WRITE(V17)
{
  if (Lock == 0 && flag == 0)
  {
    flag = 1;
    Blynk.virtualWrite(V2, "CAL10");
    Blynk.virtualWrite(V3, "pH");
    alphaH = (IsoP - 10) / voltage / (T + temp);
    SaveSet();
  }
  else if (Lock == 0 && flag == 1)
  {
    flag = 0;
  }
}

BLYNK_WRITE(V18)
{
  if (Lock == 0 && flag == 0)
  {
    flag = 1;
    Blynk.virtualWrite(V2, "Res.");
    Blynk.virtualWrite(V3, "pH");
    IsoP = 7.5099949836;
    alphaL = 0.0778344535;
    alphaH = 0.0850976657;
    SaveSet();
  }
  else if (Lock == 0 && flag == 1)
  {
    flag = 0;
  }
}

void SaveSet()
{
  int eeAddress = 0;
  MyObject customVar = {
    IsoP,
    alphaL,
    alphaH,
    pHlow,
    pHhigh,
    dose,
    LogUp,
    LogDown,
    pHdelay,
    PHMode,
    Lock
  };
  EEPROM.put(eeAddress, customVar);
}

void pumpPhdown_On()
{
  digitalWrite (pumpPhdown, HIGH);
  delay (dose * 60000 / tube);
  digitalWrite (pumpPhdown, LOW);
  LogDown += dose;
}
void pumpPhup_On()
{
  digitalWrite (pumpPhup, HIGH);
  delay (dose * 60000 / tube);
  digitalWrite (pumpPhup, LOW);
  LogUp += dose;
}

void loop()
{

  if (millis() - Time >= Interval)
  {
    Time = millis();
    s++;

    if (lan.getValue()) {
      lan.off();
      BLYNK_LOG("LED1: off");
    } else {
      lan.on();
      BLYNK_LOG("LED1: on");
    }

    Wire.requestFrom (9 , 5 ); // 9 is the slave address  ,4 bytes (double)
    if (Wire.available()) { // slave may send less than requested
      I2C_readAnything (temp);
      I2C_readAnything (sensorLevel);
      level.setValue(map (sensorLevel, 0, 1, 255, 0));
      haveData = true;
    }
    else
    {
      if (level.getValue()) {
        level.off();
        BLYNK_LOG("LED1: off");
      } else {
        level.on();
        BLYNK_LOG("LED1: on");
      }
      temp = tempManual;
      haveData = false;
    }

    if (PHMode == 1 && haveData == true)
    {
      digitalWrite(8, sensorLevel);
    }

      pH_read();
      pH_calculate();
      Blynk.virtualWrite(V0, pH);
      Blynk.virtualWrite(V1, temp);
      
      if (z == 0)
      {
        Blynk.virtualWrite(V2, LogDown);
        Blynk.virtualWrite(V3, LogUp);
      }

      if (z == 1)
      {
        Blynk.virtualWrite(V2, pHhigh);
        Blynk.virtualWrite(V3, "pH");
        SaveSet();
        z = 0;
      }
      if (z == 2)
      {
        Blynk.virtualWrite(V2,  pHlow);
        Blynk.virtualWrite(V3, "pH");
        SaveSet();
        z = 0;
      }
      if (z == 3)
      {
        Blynk.virtualWrite(V2, dose);
        Blynk.virtualWrite(V3, "ml");
        SaveSet();
        z = 0;
      }
      if (z == 4)
      {
        Blynk.virtualWrite(V2, pHdelay);
        Blynk.virtualWrite(V3, "min");
        SaveSet();
        z = 0;
      }

    if ((s / 60) >= pHdelay)
    {
      if (pHhigh > pHlow && pHlow > pH && pH > 0 && PHMode == 1 && sensorLevel == 0) // if the automatic mode is selected and the pH dropped
        // Parameter below pH Low
      {
        pumpPhup_On();
        SaveSet();
      }

      if (pHlow < pHhigh && pHhigh < pH && pH < 14 && PHMode == 1 && sensorLevel == 0) // if the automatic mode is selected and the pH rose
        // Parameter above pH High
      {
        pumpPhdown_On();
        SaveSet();
      }
      s = 0; // nulling timer
    }
  }


  Blynk.run();

}

/*-----------------------------------End loop---------------------------------------*/



